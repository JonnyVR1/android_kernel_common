## Documentation/devicetree/bindings/misc/ramoops.txt
```
Ramoops oops/panic logger
=========================

See Documentation/ramoops.txt.  The bindings here are modelled after the ramoops
kernel module parameters.


Required properties:

- compatible: must be "ramoops"

- memory-region: phandle to a region of memory that is preserved between reboots


Optional properties:

- ecc-size: enables ECC support and specifies ECC buffer size in bytes

- record-size: size in bytes of each dump done on oops/panic

- console-size: size in bytes of kernel console log

- ftrace-size: size in bytes of ftrace log

- pmsg-size: size in bytes of user space message log

- unbuffered: if present, use pgprot_noncached to map reserved region
  (defaults to pgprot_writecombine)

- no-dump-oops: if present, only dump panics (defaults to panics and oops)
```

## arch/arm/common/Kconfig
```kconfig
config ARM_GIC
	bool

config ARM_VIC
	bool

config ARM_VIC_NR
	int
	default 2
	depends on ARM_VIC
	help
	  The maximum number of VICs available in the system, for
	  power management.

config ICST
	bool

config PL330
	bool

config SA1111
	bool
	select DMABOUNCE if !ARCH_PXA

config DMABOUNCE
	bool
	select ZONE_DMA

config TIMER_ACORN
	bool

config SHARP_LOCOMO
	bool

config SHARP_PARAM
	bool

config SHARP_SCOOP
	bool

config COMMON_CLKDEV
	bool
	select HAVE_CLK

config FIQ_DEBUGGER
	bool
	select FIQ

config FIQ_DEBUGGER_NO_SLEEP
	bool
	depends on FIQ_DEBUGGER

config FIQ_DEBUGGER_WAKEUP_IRQ_ALWAYS_ON
	bool
	depends on FIQ_DEBUGGER

config FIQ_DEBUGGER_CONSOLE
	bool
	depends on FIQ_DEBUGGER
```

## drivers/bthid/Kconfig
```kconfig
#
# BTHID Configuration
#

config BTHID
	tristate "Bluetooth HID driver"
	default y
	depends on HID
	---help---
	  Android Bluetooth HID driver.
	  This driver is required if you want to use Bluetooth devices with
	  HID interface.

	  Say Y here to compile support for Bluetooth HID devices into the
	  kernel or say M to compile it as module (bthid).
```

## drivers/staging/android/ion/Kconfig
```kconfig
menuconfig ION
	tristate "Ion Memory Manager"
	depends on ARM
	select GENERIC_ALLOCATOR
	select DMA_SHARED_BUFFER
	help
	  Chose this option to enable the ION Memory Manager.

config ION_DUMMY
	tristate "Dummy Ion driver"
	depends on ION
	help
	  Provides a dummy ION driver that registers the
	  /dev/ion device and some basic heaps. This can
	  be used for testing the ION infrastructure if
	  one doesn't have access to hardware drivers that
	  use ION.

config ION_TEGRA
	tristate "Ion for Tegra"
	depends on ARCH_TEGRA && ION
	help
	  Choose this option if you wish to use ion on an nVidia Tegra.
```

## drivers/staging/iio/imu/mpu/Kconfig
```kconfig
#
# inv-mpu drivers for Invensense MPU devices and combos
#

config INV_MPU_IIO
    tristate "Invensense MPU devices"
    depends on I2C && SYSFS && IIO && IIO_SW_RING && IIO_TRIGGER && !INV_MPU 
    default n
    help
      This driver supports the Invensense MPU devices.
      This driver can be built as a module. The module will be called
      inv-mpu-iio.
```

## drivers/video/adf/Kconfig
```kconfig
menuconfig ADF
	select SYNC
	select SW_SYNC
	tristate "Atomic Display Framework"

menuconfig ADF_DISPLAY_CORE
	depends on ADF
	depends on DISPLAY_CORE
	tristate "Helper for implementing ADF interface ops with Display Core devices"

menuconfig ADF_MEMBLOCK
	depends on ADF
	depends on HAVE_MEMBLOCK
	tristate "Helper for using memblocks as buffers in ADF drivers"
```

## drivers/video/tegra/Kconfig
```kconfig
config TEGRA_GRHOST
	tristate "Tegra graphics host driver"
	depends on TEGRA_IOVMM
        default n
	help
	  Driver for the Tegra graphics host hardware.
```
